AUTOSAR XML (schema 00052)
package /Interfaces
  4 x sender receiver interface:
    VehSpdLgt
      data VehSpdLgt: category=VALUE, sw-calibration-access=READ-ONLY, type=float32
    VehSpdSetPt
      data VehSpdSetPt: category=VALUE, sw-calibration-access=READ-ONLY, type=float32
    CcEna
      data CcEna: category=VALUE, sw-calibration-access=READ-ONLY, type=boolean
    EngTqReq
      data EngTqReq: category=VALUE, sw-calibration-access=READ-ONLY, type=float32
